/* SPDX-License-Identifier: CC-BY-NC-4.0 */
/* Auromix contributors. GENERATED by build_firmware_example.py. */
#include "fpl01_lower_example.h"
#include <string.h>
static const uint16_t dot_index[42] = {10,11,0,1,2,3,4,5,6,7,8,9,18,19,20,21,22,23,24,25,26,27,36,37,38,39,40,41,42,43,44,45,46,47,48,55,56,57,60,62,64,66};
static const uint8_t op_0[] = {0};
static const uint8_t op_1[] = {92};
static const uint8_t op_2[] = {0};
static const uint8_t op_3[] = {0};
static const uint8_t op_4[] = {81};
static const uint8_t op_5[] = {0,255,255,255};
static const uint8_t op_6[] = {127,127,127};
static const uint8_t op_7[] = {0,0,0,0,0,0,0,0,0,0,0,0,0,0,0,0,0,0,0,0,0,0,0,0,0,0,0,0,0,0,0,0,0,0,0,0,0,0,0,0,0,0,0,0,0,0,0,0,0,0,0,0,0,0,0};
static const uint8_t op_8[] = {255,15,0,255,3,0,255,31,0,78,21,0,0,0,0,0,0,0,0,0,0,0,0,0,0,0,0,0,0,0,0,0,0};
static const uint8_t op_9[] = {255,255,255,255,255,255,255,255,255,255,255,255,0,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0,0};
static const uint8_t op_10[] = {0,0,0,0,0,0,0,0,0,0,0,0,0,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0,0};
static const uint8_t op_11[] = {1};
static int write_read(const fpl01_lower_io *io, uint16_t addr, const uint8_t *p, size_t n) {
    uint8_t got[396];
    if (n > sizeof got || io->write_reg(addr,p,n)) return -1;
    if (io->read_reg(addr,got,n)) return -2;
    return memcmp(p,got,n) ? -3 : 0;
}
int fpl01_lower_init_dark(const fpl01_lower_io *io) {
    /* Caller applied VCC/VLED/VIO in reviewed order. Never drives SPI with VIO off. */
    io->vsync(0); io->delay_us(500);
    if (write_read(io, 0x000, op_0, sizeof op_0)) return -1;
    if (write_read(io, 0x001, op_1, sizeof op_1)) return -2;
    if (write_read(io, 0x002, op_2, sizeof op_2)) return -3;
    if (write_read(io, 0x003, op_3, sizeof op_3)) return -4;
    if (write_read(io, 0x004, op_4, sizeof op_4)) return -5;
    if (write_read(io, 0x005, op_5, sizeof op_5)) return -6;
    if (write_read(io, 0x009, op_6, sizeof op_6)) return -7;
    if (write_read(io, 0x00C, op_7, sizeof op_7)) return -8;
    if (write_read(io, 0x043, op_8, sizeof op_8)) return -9;
    if (write_read(io, 0x100, op_9, sizeof op_9)) return -10;
    if (write_read(io, 0x200, op_10, sizeof op_10)) return -11;
    if (write_read(io, 0x000, op_11, sizeof op_11)) return -12;
    io->delay_us(100);
    io->vsync(1); io->delay_us(200); io->vsync(0);
    return 0;
}
int fpl01_lower_frame(const fpl01_lower_io *io, const uint16_t pixel[42], uint8_t master) {
    /* Chip stays at explicit 3 mA first-light setting; no automatic 20 mA enable. */
    uint8_t frame[396] = {0};
    for (size_t i=0;i<42;i++) {
        size_t a=2u*dot_index[i]; frame[a]=(uint8_t)pixel[i]; frame[a+1]=(uint8_t)(pixel[i]>>8);
    }
    io->vsync(0);
    if (io->write_reg(0x005,&master,1)) return -1;
    if (io->write_reg(0x200,frame,sizeof frame)) return -2;
    io->vsync(1); io->delay_us(200); io->vsync(0);
    return 0;
}
void fpl01_lower_spi_header(uint16_t a, int write, uint8_t h[2]) {
    /* Caller restricts a <= 0x3ff; callback owns SS and complete transaction. */
    h[0]=(uint8_t)(a>>2); h[1]=(uint8_t)(((a&3u)<<6)|(write?0x20:0));
}
